#include <algorithm>
#include <array>
#include <cstdint>
#include <cstdlib>
#include <vector>

#include "axp2101.hpp"
#include "battery_curve.hpp"
#include "check.hpp"

namespace {

using Charge = hg::BatteryPercent::Charge;

// Nox, 2026-10-08 22:40:27 to 2026-10-09 04:03:28: seconds since unplugging and
// battery millivolts, every 30 s while connected, from full until shutdown.
struct Sample {
  uint32_t t;
  uint16_t mv;
};
const Sample kNight[] = {
    {0,4105},{33,4109},{63,4092},{93,4088},{124,4080},{5017,3873},{5048,3868},{5083,3869},{6711,3825},{6742,3825},
    {6777,3827},{6811,3811},{6841,3823},{6877,3824},{6907,3822},{6937,3801},{6972,3819},{7002,3819},{7032,3818},
    {7067,3816},{7097,3813},{7127,3815},{7157,3813},{7187,3813},{7217,3808},{7247,3810},{7283,3809},{7318,3807},
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    {19180,3157},{19218,3133},{19251,3120},{19281,3101},{19311,3083},{19346,3057},{19381,3021},
};
constexpr uint32_t kShutdown = 19381;

// Charging from empty, 2026-10-09 04:32:54 until charge done at 07:05:18 (the
// charge curve's source), and 2026-10-08 20:11 until charge done at 22:05:34,
// which the curve wasn't fitted to. Seconds since plugging in, millivolts.
const Sample kChargeFromEmpty[] = {
    {0,3316},{30,3357},{60,3386},{90,3412},{125,3439},{155,3457},{186,3474},{220,3493},
    {255,3509},{285,3523},{315,3535},{346,3546},{380,3557},{411,3564},{441,3569},{471,3574},
    {501,3578},{531,3581},{566,3583},{596,3587},{631,3591},{666,3593},{701,3596},{732,3599},
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    {9054,4192},{9089,4192},{9119,4193},
};
constexpr uint32_t kChargeDone = 9144;
const Sample kEveningCharge[] = {
    {0,3675},{35,3683},{65,3689},{95,3694},{130,3698},{160,3703},{195,3707},{225,3710},{255,3712},{285,3714},
    {316,3717},{346,3720},{376,3721},{406,3723},{441,3726},{471,3728},{506,3731},{536,3733},{566,3736},
    {596,3737},{631,3740},{662,3743},{706,3746},{752,3748},{786,3750},{816,3753},{851,3755},{881,3757},
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    {6742,4192},{6772,4193},{6807,4193},{6837,4193},
};
constexpr uint32_t kEveningDone = 6852;

// Percent charged at `t` before "done", for a charge that grows with time and
// takes kChargeDone from empty.
int charged_at(uint32_t t, uint32_t done) {
  return 100 - static_cast<int>((done - t) * 100 / kChargeDone);
}

struct Replay {
  int worst = 0, total = 0, n = 0;
  bool fell = false;
};

Replay replay_charge(const Sample* samples, size_t count, uint32_t done) {
  hg::BatteryPercent percent(hg::kAmoled175cCurve, hg::kAmoled175cChargeCurve);
  Replay r;
  int last = -1;
  uint32_t prev = 0;
  for (size_t i = 0; i < count; ++i) {
    const Sample& s = samples[i];
    const int reads = i && s.t - prev > 60 ? 12 : 6;  // 5 s reads; refill after a logging gap
    prev = s.t;
    int shown = 0;
    for (int k = 0; k < reads; ++k) shown = percent.update(s.mv, Charge::Charging, uint8_t(1));
    if (shown < last) r.fell = true;
    last = shown;
    const int err = std::abs(shown - charged_at(s.t, done));
    r.worst = std::max(r.worst, err);
    r.total += err;
    ++r.n;
  }
  return r;
}

// The AMOLED-2.06, 2026-10-16 02:43 to 2026-10-17 01:55 (unplugged at 4.1 V; plugged in again at
// 3.48 V): seconds since unplugging, millivolts and the screen lit, every row of the log (30 s lit,
// 5 min dark: the device reads every 5 s either way, and reports that often).
struct LitSample {
  uint32_t t;
  uint16_t mv;
  uint8_t lit;
};
const LitSample kQuietDay[] = {
    {0,4042,0},{35,4042,0},{70,4041,0},{105,4040,0},{139,4037,0},{174,4038,0},{209,4037,0},{244,4038,0},{279,4037,0},{315,4038,0},
    {349,4038,0},{381,3927,1},{411,4005,1},{441,3982,1},{474,4010,1},{505,4010,1},{537,4009,1},{569,4013,0},{603,4017,0},{638,4018,0},
    {668,3937,1},{700,3999,1},{732,3974,1},{762,3938,1},{792,3967,1},{822,3964,1},{852,3926,1},{882,3960,1},{912,3958,1},{947,3953,1},
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    {81867,3527,0},{82185,3525,0},{82535,3524,0},{82856,3522,0},{83172,3522,0},{83492,3520,0},{83537,3481,0},
};

}  // namespace

TEST("battery curve: the AMOLED-2.06 table falls monotonically from full to the cut-off") {
  const hg::Curve c = hg::kAmoled206Curve;
  for (size_t i = 1; i < c.size; ++i) {
    CHECK(c.points[i].mv < c.points[i - 1].mv);
    CHECK(c.points[i].percent < c.points[i - 1].percent);
  }
  CHECK_EQ(hg::percent_on_curve(c, 3400), uint8_t(0));  // the app's cut-off
}

TEST("charge curve: the AMOLED-2.06 charge table rises from 10 to 96; charging holds it below 100 until done") {
  const hg::Curve c = hg::kAmoled206ChargeCurve;
  for (size_t i = 1; i < c.size; ++i) {
    CHECK(c.points[i].mv < c.points[i - 1].mv);
    CHECK(c.points[i].percent < c.points[i - 1].percent);
  }
  hg::BatteryPercent percent(hg::kAmoled206Curve, c);
  for (int i = 0; i < 60; ++i) percent.update(3506, Charge::Discharging, std::nullopt);  // 15% on battery
  CHECK_EQ(percent.update(3506, Charge::Discharging, std::nullopt), uint8_t(15));
  CHECK_EQ(percent.update(3690, Charge::Charging, std::nullopt), uint8_t(15));  // plugged in: no drop below it
  for (int i = 0; i < 60; ++i) percent.update(3852, Charge::Charging, std::nullopt);
  CHECK_EQ(percent.update(3852, Charge::Charging, std::nullopt), uint8_t(50));
  for (int i = 0; i < 60; ++i) percent.update(4102, Charge::Charging, std::nullopt);  // the taper at 4.1 V
  const uint8_t taper = percent.update(4102, Charge::Charging, std::nullopt);
  CHECK(taper >= 88 && taper <= 96);
  CHECK_EQ(percent.update(4060, Charge::Done, std::nullopt), uint8_t(100));
}

TEST("battery curve: replaying the 2.06's quiet day, the percent falls with the charge, lit or not") {
  // The device reads every 5 s; the log keeps one reading a row. Between rows it read what the
  // rows around say (the median of five: a dip in one row is one reading, a passing load), and the
  // row's own reading once. Lit readings get the 35 mV back, as Axp2101::set_sag_mv does. The
  // charge left by its drain (11.8 mA dark, 25 more lit) out of 353 mAh to the cut-off.
  hg::BatteryPercent percent(hg::kAmoled206Curve);
  const size_t n = sizeof(kQuietDay) / sizeof(kQuietDay[0]);
  double used = 0, sum = 0;
  int last = 101, worst = 0;
  for (size_t i = 1; i < n; ++i) {
    const LitSample& s = kQuietDay[i];
    const uint32_t gap = s.t - kQuietDay[i - 1].t;
    used += gap / 3600.0 * (s.lit ? 36.8 : 11.8);
    uint16_t near[5];
    size_t m = 0;
    for (size_t j = i >= 2 ? i - 2 : 0; j < std::min(n, i + 3); ++j) near[m++] = kQuietDay[j].mv;
    std::sort(near, near + m);
    auto read = [&](uint16_t mv) { return percent.update(static_cast<uint16_t>(mv + (s.lit ? 35 : 0)), Charge::Discharging, std::nullopt); };
    int shown = 0;
    for (uint32_t k = 5; k < std::min<uint32_t>(gap, 300); k += 5) shown = read(near[m / 2]);
    shown = read(s.mv);
    CHECK(shown <= last);
    last = shown;
    const int left = static_cast<int>(100 - used * 100 / 353);
    worst = std::max(worst, std::abs(shown - left));
    sum += std::abs(shown - left);
  }
  // Within 5 on average; 15 at worst, after two 15-minute loads with the screen dark (the voltage
  // can't tell a load from charge spent, and the shown percent waits for the charge to catch up).
  // The AXP2101's gauge was off by up to 26.
  CHECK(sum / (n - 1) <= 5.0);
  CHECK(worst <= 16);
  CHECK(last >= 15 && last <= 21);  // it ended at 18% left
}

TEST("battery curve: interpolates between points and clamps at both ends") {
  CHECK_EQ(hg::percent_on_curve(hg::kAmoled175cCurve, 4200), uint8_t(100));
  CHECK_EQ(hg::percent_on_curve(hg::kAmoled175cCurve, 4100), uint8_t(100));
  CHECK_EQ(hg::percent_on_curve(hg::kAmoled175cCurve, 3704), uint8_t(49));
  CHECK_EQ(hg::percent_on_curve(hg::kAmoled175cCurve, 3729), uint8_t(52));  // halfway 3704..3754
  CHECK_EQ(hg::percent_on_curve(hg::kAmoled175cCurve, 3050), uint8_t(0));
  CHECK_EQ(hg::percent_on_curve(hg::kAmoled175cCurve, 2900), uint8_t(0));
}

TEST("battery curve: the 1.75C table falls monotonically from full to empty") {
  const hg::Curve c = hg::kAmoled175cCurve;
  for (size_t i = 1; i < c.size; ++i) {
    CHECK(c.points[i].mv < c.points[i - 1].mv);
    CHECK(c.points[i].percent < c.points[i - 1].percent);
  }
}

TEST("battery curve: replaying the measured night, the shown percent never rises and tracks the charge left") {
  hg::BatteryPercent percent(hg::kAmoled175cCurve);
  int last = 101, worst = 0;
  uint32_t prev = 0;
  for (const Sample& s : kNight) {
    // The device reads every 5 s; the log has a row every 30 s, except across two
    // stretches where it was offline (no rows) while still reading. After such a
    // gap, give the window the minute of readings it would have had.
    const int reads = s.t - prev > 60 ? 12 : 6;
    prev = s.t;
    int shown = 0;
    for (int i = 0; i < reads; ++i) shown = percent.update(s.mv, Charge::Discharging, std::nullopt);
    CHECK(shown <= last);
    last = shown;
    const int left = static_cast<int>((kShutdown - s.t) * 100 / kShutdown);
    worst = std::max(worst, std::abs(shown - left));
  }
  CHECK(worst <= 3);  // the gauge was off by up to 14 points over the same night
  CHECK(last <= 1);
}

TEST("battery curve: a lighter load lifting the voltage doesn't raise the percent") {
  hg::BatteryPercent percent(hg::kAmoled175cCurve);
  for (int i = 0; i < 12; ++i) percent.update(3704, Charge::Discharging, std::nullopt);
  CHECK_EQ(percent.update(3704, Charge::Discharging, std::nullopt), uint8_t(49));
  for (int i = 0; i < 12; ++i) percent.update(3754, Charge::Discharging, std::nullopt);  // screen off: +50 mV
  CHECK_EQ(percent.update(3754, Charge::Discharging, std::nullopt), uint8_t(49));
}

TEST("battery curve: one stray reading doesn't move it; a minute of lower readings does") {
  hg::BatteryPercent percent(hg::kAmoled175cCurve);
  for (int i = 0; i < 12; ++i) percent.update(3754, Charge::Discharging, std::nullopt);
  CHECK_EQ(percent.update(3600, Charge::Discharging, std::nullopt), uint8_t(55));  // a load spike
  for (int i = 0; i < 12; ++i) percent.update(3704, Charge::Discharging, std::nullopt);
  CHECK_EQ(percent.update(3704, Charge::Discharging, std::nullopt), uint8_t(49));
}

TEST("battery curve: charging shows the gauge, charged shows 100, unplugging starts afresh") {
  hg::BatteryPercent percent(hg::kAmoled175cCurve);
  for (int i = 0; i < 12; ++i) percent.update(3600, Charge::Discharging, std::nullopt);
  CHECK_EQ(percent.update(4150, Charge::Charging, uint8_t(40)), uint8_t(40));  // not the curve: voltage reads high
  CHECK_EQ(percent.update(4150, Charge::Charging, std::nullopt), uint8_t(100));  // no gauge: the curve, best effort
  CHECK_EQ(percent.update(4180, Charge::Done, uint8_t(97)), uint8_t(100));
  CHECK_EQ(percent.update(4120, Charge::Discharging, std::nullopt), uint8_t(100));  // not held at the old 32%
}

TEST("AXP2101: with a curve, the percent comes from it on battery and from the gauge on charge") {
  std::array<uint8_t, 256> regs{};
  regs[0x00] = 0x08;  // battery, no USB
  regs[0x01] = 0x45;  // discharging, not charging
  regs[0x18] = 0x0a;  // gauge on
  regs[0x30] = 0x03;  // voltage ADC on
  regs[0x34] = 0x0e;  // 3704 mV
  regs[0x35] = 0x78;
  regs[0xa4] = 36;    // the gauge's lower estimate
  hg::Axp2101 power(
      [&](uint8_t reg, uint8_t* out, size_t n) {
        for (size_t i = 0; i < n; ++i) out[i] = regs[reg + i];
        return true;
      },
      [&](uint8_t, uint8_t) { return true; });
  CHECK_EQ(power.read()->battery_percent, uint8_t(36));  // no curve: the gauge, as before
  power.use_curves(hg::kAmoled175cCurve);  // no charge curve: the gauge on charge
  CHECK_EQ(power.read()->battery_mv, uint16_t(3704));
  CHECK_EQ(power.read()->battery_percent, uint8_t(49));
  regs[0x00] = 0x28;  // USB in
  regs[0x01] = 0x22;  // charging, constant current
  CHECK_EQ(power.read()->battery_percent, uint8_t(36));
  regs[0x01] = 0x04;  // charge done
  CHECK_EQ(power.read()->battery_percent, uint8_t(100));
}

TEST("charge curve: replaying the charge from empty, it never falls and tracks the charge added") {
  const Replay r = replay_charge(kChargeFromEmpty, sizeof(kChargeFromEmpty) / sizeof(kChargeFromEmpty[0]), kChargeDone);
  CHECK(!r.fell);
  CHECK(r.worst <= 2);
}

TEST("charge curve: on a charge it wasn't fitted to, it stays close; the gauge read up to 18 low") {
  const Replay r = replay_charge(kEveningCharge, sizeof(kEveningCharge) / sizeof(kEveningCharge[0]), kEveningDone);
  CHECK(!r.fell);
  CHECK(r.total <= 2 * r.n);  // within 2 points on average
  CHECK(r.worst <= 7);        // the first minutes after plugging in, before the voltage settles
}

TEST("charge curve: plugging in never drops below what battery showed; it holds 99 until done") {
  hg::BatteryPercent percent(hg::kAmoled175cCurve, hg::kAmoled175cChargeCurve);
  for (int i = 0; i < 12; ++i) percent.update(3704, Charge::Discharging, std::nullopt);
  CHECK_EQ(percent.update(3704, Charge::Discharging, std::nullopt), uint8_t(49));
  CHECK_EQ(percent.update(3740, Charge::Charging, std::nullopt), uint8_t(49));  // charge curve says 31
  for (int i = 0; i < 12; ++i) percent.update(3904, Charge::Charging, std::nullopt);
  CHECK_EQ(percent.update(3904, Charge::Charging, std::nullopt), uint8_t(54));
  for (int i = 0; i < 12; ++i) percent.update(4205, Charge::Charging, std::nullopt);
  CHECK_EQ(percent.update(4205, Charge::Charging, std::nullopt), uint8_t(99));
  CHECK_EQ(percent.update(4190, Charge::Done, std::nullopt), uint8_t(100));
}

TEST("charge curve: a few seconds on USB don't lift the percent; unplugging keeps what charging showed") {
  // 2026-10-18 14:52: 18% on battery, 15 s on USB, then the first reading off it 3570 mV with the
  // lit screen's 35 mV added back (39% on the curve).
  hg::BatteryPercent percent(hg::kAmoled206Curve, hg::kAmoled206ChargeCurve);
  for (int i = 0; i < 60; ++i) percent.update(3528, Charge::Discharging, std::nullopt);
  const uint8_t before = percent.update(3528, Charge::Discharging, std::nullopt);
  CHECK_EQ(percent.update(3713, Charge::Charging, std::nullopt), before);
  CHECK_EQ(percent.update(3713, Charge::Charging, std::nullopt), before);
  CHECK_EQ(percent.update(3605, Charge::Discharging, std::nullopt), before);  // not 39
  for (int i = 0; i < 60; ++i) percent.update(3506, Charge::Discharging, std::nullopt);
  CHECK_EQ(percent.update(3506, Charge::Discharging, std::nullopt), uint8_t(15));  // and still falls
  // A longer charge: off the charger it shows what charging reached, not the higher reading.
  for (int i = 0; i < 60; ++i) percent.update(3852, Charge::Charging, std::nullopt);
  CHECK_EQ(percent.update(3852, Charge::Charging, std::nullopt), uint8_t(50));
  CHECK_EQ(percent.update(3700, Charge::Discharging, std::nullopt), uint8_t(50));  // 63 on the curve
}

TEST("charge curve: a top-up after charging is done keeps showing 100; unplugging starts afresh") {
  hg::BatteryPercent percent(hg::kAmoled175cCurve, hg::kAmoled175cChargeCurve);
  CHECK_EQ(percent.update(4190, Charge::Done, std::nullopt), uint8_t(100));
  // Left on USB, the PMIC tops the cell up again once it sags: the charge curve
  // alone would read about 83 here.
  for (int i = 0; i < 12; ++i) CHECK_EQ(percent.update(4120, Charge::Charging, std::nullopt), uint8_t(100));
  CHECK_EQ(percent.update(4195, Charge::Done, std::nullopt), uint8_t(100));
  CHECK_EQ(percent.update(4050, Charge::Discharging, std::nullopt), uint8_t(94));  // the discharge curve, not held at 100
}

TEST("charge curve: the 1.75C charge table rises monotonically from empty to 99") {
  const hg::Curve c = hg::kAmoled175cChargeCurve;
  CHECK_EQ(c.points[0].percent, uint8_t(99));
  for (size_t i = 1; i < c.size; ++i) {
    CHECK(c.points[i].mv < c.points[i - 1].mv);
    CHECK(c.points[i].percent < c.points[i - 1].percent);
  }
}

TEST("AXP2101: the charge current limit decodes both step sizes, and reserved values are unknown") {
  uint8_t icc = 0x09;
  hg::Axp2101 power(
      [&](uint8_t reg, uint8_t* out, size_t) {
        *out = reg == 0x62 ? icc : 0;
        return true;
      },
      [&](uint8_t, uint8_t) { return false; });
  CHECK(power.charge_current_ma() == std::optional<uint16_t>(300));  // the datasheet default (Nox reads 200)
  icc = 0x04;
  CHECK(power.charge_current_ma() == std::optional<uint16_t>(100));
  icc = 0x15;
  CHECK(power.charge_current_ma() == std::optional<uint16_t>(1500));
  icc = 0x16;
  CHECK(!power.charge_current_ma().has_value());
}

TEST("AXP2101: the charge programme decodes the charger registers and VOFF") {
  uint8_t regs[256] = {};
  regs[0x61] = 0x05;  // 125 mA precharge
  regs[0x62] = 0x09;  // 300 mA
  regs[0x63] = 0x15;  // termination on, 125 mA
  regs[0x64] = 0x03;  // 4.2 V
  regs[0x24] = 0x00;  // 2.6 V, the factory cut
  hg::Axp2101 power(
      [&](uint8_t reg, uint8_t* out, size_t) {
        *out = regs[reg];
        return true;
      },
      [&](uint8_t, uint8_t) { return false; });
  auto p = power.charge_programme();
  CHECK(p.has_value());
  CHECK(p->precharge_ma == std::optional<uint16_t>(125));
  CHECK(p->cc_ma == std::optional<uint16_t>(300));
  CHECK(p->term_enabled);
  CHECK(p->term_ma == std::optional<uint16_t>(125));
  CHECK(p->target_mv == std::optional<uint16_t>(4200));
  CHECK(p->voff_mv == std::optional<uint16_t>(2600));
  regs[0x64] = 0x02;  // 4.1 V
  regs[0x24] = 0x03;  // 2.9 V
  regs[0x63] = 0x01;  // termination off
  p = power.charge_programme();
  CHECK(p->target_mv == std::optional<uint16_t>(4100));
  CHECK(p->voff_mv == std::optional<uint16_t>(2900));
  CHECK(!p->term_enabled);
  regs[0x64] = 0x07;  // reserved
  CHECK(!power.charge_programme()->target_mv.has_value());
}

TEST("AXP2101: battery care writes only the fields that differ and keeps the other bits") {
  uint8_t regs[256] = {};
  regs[0x61] = 0xA5;  // 125 mA precharge, high bits reserved
  regs[0x62] = 0x09;  // 300 mA
  regs[0x63] = 0x15;  // termination on, 125 mA
  regs[0x64] = 0x03;  // 4.2 V
  regs[0x24] = 0x00;  // 2.6 V
  int writes = 0;
  hg::Axp2101 power(
      [&](uint8_t reg, uint8_t* out, size_t) {
        *out = regs[reg];
        return true;
      },
      [&](uint8_t reg, uint8_t v) {
        regs[reg] = v;
        ++writes;
        return true;
      });
  // The 2.06" board's 400 mAh cell: 0.5 C, 4.1 V, C/8, VOFF 2.9 V.
  const hg::Axp2101::ChargeTarget care{50, 200, 50, 4100, 2900};
  CHECK(power.program_charger(care));
  CHECK_EQ(regs[0x61], uint8_t(0xA2));
  CHECK_EQ(regs[0x62], uint8_t(0x08));
  CHECK_EQ(regs[0x63], uint8_t(0x12));
  CHECK_EQ(regs[0x64], uint8_t(0x02));
  CHECK_EQ(regs[0x24], uint8_t(0x03));
  CHECK_EQ(writes, 5);
  auto p = power.charge_programme();
  CHECK(p->cc_ma == std::optional<uint16_t>(200));
  CHECK(p->target_mv == std::optional<uint16_t>(4100));
  CHECK(p->term_ma == std::optional<uint16_t>(50));
  CHECK(p->voff_mv == std::optional<uint16_t>(2900));
  CHECK(power.program_charger(care));  // the next boot: nothing to change
  CHECK_EQ(writes, 5);
  CHECK(power.program_charger({50, 400, 50, 4100, 2900}));  // 400 mA: the 100 mA steps
  CHECK_EQ(regs[0x62], uint8_t(0x0A));
  CHECK(!power.program_charger({50, 210, 50, 4100, 2900}));  // not a step: nothing written
  CHECK(!power.program_charger({50, 200, 50, 4150, 2900}));
  CHECK(!power.program_charger({50, 200, 50, 4100, 3400}));
  CHECK_EQ(regs[0x62], uint8_t(0x0A));
}
